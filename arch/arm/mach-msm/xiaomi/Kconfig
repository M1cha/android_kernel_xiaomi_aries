## arch/arm/mach-msm/xiaomi/Kconfig
```kconfig
config MACH_XIAOMI
	bool

menu "Xiaomi Board Selection"
source "arch/arm/mach-msm/xiaomi/Kconfig.board"
endmenu


menu "Xiaomi Specific Patches"

config XIAOMI_EARJACK_UART
	bool "Earjack UART"
	default n
	depends on MACH_XIAOMI
	help
	  Enable Earjack UART debugger. This disables headphone support

endmenu
```

## arch/arm/mach-msm/xiaomi/Kconfig.board
```kconfig
#
# Inlcude the specific Kconfig file for Xiaomi board
#
# ARIES
source "arch/arm/mach-msm/xiaomi/aries/Kconfig"

config MACH_XIAOMI_DUMMY
	bool "NONE (No device)"
```

## arch/arm/mach-msm/xiaomi/aries/Kconfig
```kconfig
config MACH_APQ8064_ARIES
	depends on ARCH_APQ8064
	select MACH_XIAOMI
	bool "APQ8064 ARIES"
	help
	  Support for the Xiaomi ARIES device.
```

## drivers/media/platform/msm/Kconfig
```kconfig
#
# MSM camera configuration
#

comment "Qualcomm MSM Camera And Video"

menuconfig MSM_CAMERA
        bool "Qualcomm MSM camera and video capture support"
        depends on ARCH_MSM && VIDEO_V4L2 && I2C
        default y
        help
          Say Y here to enable selecting the video adapters for
          Qualcomm msm camera and video encoding

config MSM_CAMERA_DEBUG
        bool "Qualcomm MSM camera debugging with printk"
        depends on MSM_CAMERA
        default n
        help
          Enable printk() debug for msm camera

menuconfig MSM_CAMERA_LEGACY
        bool "Qualcomm MSM legacy camera and video capture support"
        depends on ARCH_MSM && VIDEO_V4L2 && I2C
        default y
        help
          Say Y here to enable selecting the video adapters for
          Qualcomm msm camera and video encoding

if MSM_CAMERA
if MSM_CAMERA_LEGACY
source "drivers/media/platform/msm/camera_legacy/Kconfig"
endif # MSM_CAMERA_LEGACY
endif # MSM_CAMERA
```

## drivers/video/msm/mhl/sii9244/Kconfig
```kconfig
#
# HDMI to MHL  device configuration
#

menu "MHL sii9244 support"

config FB_MSM_HDMI_MHL_RCP
	bool "FB_MSM_HDMI_MHL_RCP"
	depends on FB_MSM_HDMI_MHL_9244
	default n
	help

endmenu
```

## drivers/video/msm/mhl9244/Kconfig
```kconfig
#
# HDMI to MHL  device configuration
#

menu "MHL sii9244 support"

config FB_MSM_HDMI_MHL_9244
	depends on FB_MSM_HDMI_MSM_PANEL
	bool 'SI_MHL 9244 support'
	default n
	---help---
	  Support the HDMI to MHL conversion.
	  MHL (Mobile High-Definition Link) technology
	  uses USB connector to output HDMI content

config FB_MSM_HDMI_MHL_RCP
	bool "FB_MSM_HDMI_MHL_RCP"
	depends on FB_MSM_HDMI_MHL_9244
	default n
	help

endmenu
```
